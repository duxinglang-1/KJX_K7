; Copyright Statement:
; --------------------
; This software is protected by Copyright and the information contained
; herein is confidential. The software may not be copied and the information
; contained herein may not be used or disclosed except with the written
; permission of MediaTek Inc. (C) 2005
; 
; BY OPENING THIS FILE, BUYER HEREBY UNEQUIVOCALLY ACKNOWLEDGES AND AGREES
; THAT THE SOFTWARE/FIRMWARE AND ITS DOCUMENTATIONS ("MEDIATEK SOFTWARE")
; RECEIVED FROM MEDIATEK AND/OR ITS REPRESENTATIVES ARE PROVIDED TO BUYER ON
; AN "AS-IS" BASIS ONLY. MEDIATEK EXPRESSLY DISCLAIMS ANY AND ALL WARRANTIES,
; EXPRESS OR IMPLIED, INCLUDING BUT NOT LIMITED TO THE IMPLIED WARRANTIES OF
; MERCHANTABILITY, FITNESS FOR A PARTICULAR PURPOSE OR NONINFRINGEMENT.
; NEITHER DOES MEDIATEK PROVIDE ANY WARRANTY WHATSOEVER WITH RESPECT TO THE
; SOFTWARE OF ANY THIRD PARTY WHICH MAY BE USED BY, INCORPORATED IN, OR
; SUPPLIED WITH THE MEDIATEK SOFTWARE, AND BUYER AGREES TO LOOK ONLY TO SUCH
; THIRD PARTY FOR ANY WARRANTY CLAIM RELATING THERETO. MEDIATEK SHALL ALSO
; NOT BE RESPONSIBLE FOR ANY MEDIATEK SOFTWARE RELEASES MADE TO BUYER'S
; SPECIFICATION OR TO CONFORM TO A PARTICULAR STANDARD OR OPEN FORUM.
; 
; BUYER'S SOLE AND EXCLUSIVE REMEDY AND MEDIATEK'S ENTIRE AND CUMULATIVE
; LIABILITY WITH RESPECT TO THE MEDIATEK SOFTWARE RELEASED HEREUNDER WILL BE,
; AT MEDIATEK'S OPTION, TO REVISE OR REPLACE THE MEDIATEK SOFTWARE AT ISSUE,
; OR REFUND ANY SOFTWARE LICENSE FEES OR SERVICE CHARGE PAID BY BUYER TO
; MEDIATEK FOR SUCH MEDIATEK SOFTWARE AT ISSUE.
; 
; THE TRANSACTION CONTEMPLATED HEREUNDER SHALL BE CONSTRUED IN ACCORDANCE
; WITH THE LAWS OF THE STATE OF CALIFORNIA, USA, EXCLUDING ITS CONFLICT OF
; LAWS PRINCIPLES.  ANY DISPUTES, CONTROVERSIES OR CLAIMS ARISING THEREOF AND
; RELATED THERETO SHALL BE SETTLED BY ARBITRATION IN SAN FRANCISCO, CA, UNDER
; THE RULES OF THE INTERNATIONAL CHAMBER OF COMMERCE (ICC).

[CMMGEN_VERNO]

GLOBAL &BIN_PATH

; CPU_info_command
SYStem.CPU [ARM]
SYStem.Up

; specify_load_elf
D.LOAD.ELF "[ELF]" /RELPATH /PATH "[PATH]" [ELFPARA]

&BIN_PATH="[BIN_PATH]"

;if the codebase support ZIMAGE, we will copy ZIMAGE RO from elf to RAM region
;conserve for backward compatibility
IF y.exist(Load$$ZIMAGE$$Base)
(
    IF y.exist(Image$$ZIMAGE$$Length)
    (
        data.copy Load$$ZIMAGE$$Base--(Load$$ZIMAGE$$Base+Image$$ZIMAGE$$Length) Image$$ZIMAGE$$Base
    )
)

[BINARY]

; add_utility_for_debugging
GLOBAL &DBGSUITE_PATH
&DBGSUITE_PATH="[DBGSUITE_PATH]"

if version.build()==0x100000 
(
    task.config &DBGSUITE_PATH\Misc\NUCLEUS
)
else
(
    if y.exist(TCT_Schedule)
    (
        task.config &DBGSUITE_PATH\Misc\NUCLEUS
        menu.reprogram &DBGSUITE_PATH\Misc\NUCLEUS
    )
    else
    (
        task.config &DBGSUITE_PATH\Misc\NUCLEUS_V2
        menu.reprogram &DBGSUITE_PATH\Misc\NUCLEUS_V2
    )
)

[DBG_BUTTON]

; clean_win_and_endup
winclear
d.l

; launch_basic_analysis
EVAL VERSION.BUILD()
LOCAL &v
&v=EVAL()
IF &v>0x4F0
(
    IF OS.FILE(&DBGSUITE_PATH\Misc\BasicAnalysis.cmm)
    (
       WINCLEAR
       PRINT "[Offline SST] progressing"
       DODECRYPT "SystemService" &DBGSUITE_PATH\Misc\BasicAnalysis.cmm
    )
    ELSE
    (
       DIALOG.OK "[Offline SST] Fail!" "BasicAnalysis.cmm not found!" "Please make sure that &DBGSUITE_PATH\Misc\BasicAnalysis.cmm exists!"
       PRINT "[Offline SST] Fail ==> BasicAnalysis.cmm not found! Please make sure that &DBGSUITE_PATH\Misc\BasicAnalysis.cmm exists!"
    )
)
ELSE
(
    DIALOG.OK "[Offline SST] Fail!" "Trace32 version mismtach" "Please upgrade to 2005/Feb or later"
    PRINT "[Offline SST Guide] Trace32 version too old to SUPPORT!"
)
enddo
